VERSION ""

NS_ :

BS_:

BU_: XXX  r 6

BO_ 1298 NEW_MSG_1: 8 XXX
 SG_ Counter : 40|8@1+ (1,0) [0|255] "" XXX
 SG_ N : 0|0@0+ (4,8) [0|1] "6" ,

BO_ 1040 NEW_MSG_2: 8 XXX
 SG_ Transmission Torque : 8|8@1+ (1,0) [0|255] "" XXX
 SG_ Engine Torque : 16|8@1+ (1,0) [0|255] "" XXX
 SG_ Torque Loss : 24|8@1+ (1,0) [0|255] "" XXX
 SG_ Accelerator Position : 32|8@1+ (1,0) [0|255] "" XXX
 SG_ Engine Speed : 47|16@0+ (1,0) [0|65535] "" XXX
 SG_ Clutch : 62|1@0+ (1,0) [0|1] "" XXX
 SG_ Unknown : 0|8@1+ (1,0) [0|255] "" XXX
